## arch/riscv32/soc/riscv-privilege/bear/Kconfig.defconfig.series
```kconfig
if SOC_SERIES_RISCV32_BEAR

config SOC_SERIES
    string
    default "bear"

config SYS_CLOCK_TICKS_PER_SEC
    int
    default 100

config SYS_CLOCK_HW_CYCLES_PER_SEC
    int
    default 1000000

config RISCV_SOC_INTERRUPT_INIT
    bool
    default y

config INCLUDE_RESET_VECTOR
    bool
    default y

config NUM_IRQS
    int
    default 14  # IRQ #0..11 are reserved according to RISC-V priv spec, IRQ #12 - UART

config RISCV_ROM_BASE_ADDR
    hex
    default 0x80000000

config RISCV_ROM_SIZE
    hex
    default 0x1000

config RISCV_RAM_BASE_ADDR
    hex
    default 0x80001000

config RISCV_RAM_SIZE_KB
    int
    default 124

endif # SOC_SERIES_RISCV32_BEAR
```

## arch/riscv32/soc/riscv-privilege/bear/Kconfig.series
```kconfig
# Kconfig - bear SOC implementation
#
# Copyright (c) 2017 Alexander Kozlov <alexander.kozlov@cloudbear.ru>
#
# SPDX-License-Identifier: Apache-2.0
#

config SOC_SERIES_RISCV32_BEAR
	bool "bear SOC implementation"
	depends on RISCV32
	select SOC_FAMILY_RISCV_PRIVILEGE
	help
	  Enable support for bear SOC implementation
```

## arch/riscv32/soc/riscv-privilege/bear/Kconfig.soc
```kconfig
# Kconfig - bear SOC configuration options
#
# Copyright (c) 2017 Alexander Kozlov <alexander.kozlov@cloudbear.ru>
#
# SPDX-License-Identifier: Apache-2.0
#

choice
prompt "bear SOC implementation"
depends on SOC_SERIES_RISCV32_BEAR

config SOC_RISCV32_BEAR
    bool "bear SOC implementation"
    select ATOMIC_OPERATIONS_C
    select HAS_BEARSDK
    select PLIC_BEAR
endchoice
```

## boards/riscv32/board_bear/board_bear_defconfig
```kconfig
CONFIG_RISCV32=y
CONFIG_SOC_SERIES_RISCV32_BEAR=y
CONFIG_SOC_RISCV32_BEAR=y
CONFIG_BOARD_BEAR=y
CONFIG_CONSOLE=y
CONFIG_PRINTK=y
CONFIG_SERIAL=y
CONFIG_UART_BEAR=y
CONFIG_UART_CONSOLE=y
CONFIG_UART_CONSOLE_ON_DEV_NAME="uart0"
CONFIG_PLIC=n
CONFIG_PLIC_BEAR=y
CONFIG_RISCV_MACHINE_TIMER=y
CONFIG_BOOT_BANNER=y
```

## drivers/serial/Kconfig.bear
```kconfig
# Kconfig.bear - BEAR UART configuration option
#
# Copyright (c) 2017 Alexander Kozlov <alexander.kozlov@cloudbear.ru>
#
# SPDX-License-Identifier: Apache-2.0
#

menuconfig UART_BEAR
    bool "BEAR UART driver"
    depends on SOC_RISCV32_BEAR
    default n
    select SERIAL_HAS_DRIVER
    select SERIAL_SUPPORT_INTERRUPT
    help
      Enable the BEAR UART driver.

# ---------- Port 0 ----------

menuconfig UART_BEAR_PORT_0
    bool "Enable BEAR Port 0"
    depends on UART_BEAR
    help
      This tells the driver to configure the UART port at boot, depending on
      the additional configure options below.

config UART_BEAR_PORT_0_NAME
    string "Port 0 Device Name"
    default "uart0"
    depends on UART_BEAR_PORT_0
    help
      This is the device name for UART, and is included in the device
      struct.

# ---------- Port 1 ----------

menuconfig UART_BEAR_PORT_1
    bool "Enable BEAR Port 1"
    depends on UART_BEAR
    help
      This tells the driver to configure the UART port at boot, depending on
      the additional configure options below.

config UART_BEAR_PORT_1_NAME
    string "Port 1 Device Name"
    default "uart1"
    depends on UART_BEAR_PORT_1
    help
      This is the device name for UART, and is included in the device
      struct.
```
